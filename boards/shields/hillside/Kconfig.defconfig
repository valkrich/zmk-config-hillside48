## boards/shields/hillside/Kconfig.defconfig
```kconfig
if SHIELD_HILLSIDE_LEFT

config ZMK_KEYBOARD_NAME
    default "Hillside"

config ZMK_SPLIT_BLE_ROLE_CENTRAL
    default y

# Enable battery level reporting for the central side
config ZMK_SPLIT_BLE_CENTRAL_BATTERY_LEVEL_PROXY
    bool "Enable central side battery level proxy"
    default y

# Enable fetching of the battery level from the peripheral side
config ZMK_SPLIT_BLE_CENTRAL_BATTERY_LEVEL_FETCHING
    bool "Enable fetching of peripheral battery level"
    default y


endif

if SHIELD_HILLSIDE_LEFT || SHIELD_HILLSIDE_RIGHT

config ZMK_SPLIT
    default y

endif
```

## boards/shields/hillside/Kconfig.shield
```kconfig
config SHIELD_HILLSIDE_LEFT
    def_bool $(shields_list_contains,hillside_left)

config SHIELD_HILLSIDE_RIGHT
    def_bool $(shields_list_contains,hillside_right)

# Enable battery level reporting for the central side
config ZMK_SPLIT_BLE_CENTRAL_BATTERY_LEVEL_PROXY
    bool "Enable central side battery level proxy"
    default y

# Enable fetching of the battery level from the peripheral side
config ZMK_SPLIT_BLE_CENTRAL_BATTERY_LEVEL_FETCHING
    bool "Enable fetching of peripheral battery level"
    default y
```
